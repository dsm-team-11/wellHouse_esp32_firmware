## main/Kconfig.projbuild
```kconfig
menu "WellHouse Configuration"

    menu "Identity & network"
        config WELLHOUSE_DEVICE_ID
            string "Device ID"
            default "demo-device-01"
            help
                Unique device identifier. Used as the MQTT client id and as the
                topic segment devices/{deviceId}/... The backend dev seed creates
                "demo-device-01" (pairingCode 123456).

        config WELLHOUSE_MQTT_BROKER_URI
            string "MQTT broker URI"
            default "mqtt://192.168.0.10:1883"
            help
                mqtt://host:1883 (plain) or mqtts://host:8883 (TLS, validated
                against the bundled CA store). Point this at the Mosquitto broker
                the backend uses.

        config WELLHOUSE_MQTT_USERNAME
            string "MQTT username (optional)"
            default ""
            help
                Leave empty for the anonymous dev broker. For an authenticated
                broker, convention is username = deviceId.

        config WELLHOUSE_MQTT_PASSWORD
            string "MQTT password (optional)"
            default ""
            help
                Leave empty for the anonymous dev broker. For an authenticated
                broker, use the deviceToken issued by the pairing flow.

        config WELLHOUSE_WIFI_SSID
            string "Wi-Fi SSID"
            default "your-ssid"

        config WELLHOUSE_WIFI_PASSWORD
            string "Wi-Fi password"
            default "your-password"

        config WELLHOUSE_SNTP_SERVER
            string "SNTP server"
            default "pool.ntp.org"
    endmenu

    menu "Timing & storage"
        config WELLHOUSE_HEARTBEAT_MS
            int "Heartbeat interval (ms)"
            range 5000 600000
            default 30000

        config WELLHOUSE_WATER_PUBLISH_MS
            int "Min interval between water publishes (ms)"
            range 200 60000
            default 2000
            help
                The STM is polled far more often than this; water is published
                to the backend at most once per interval.

        config WELLHOUSE_CMD_HOLD_MS
            int "Command DANGER hold (ms)"
            range 1000 60000
            default 10000
            help
                On a backend actuation command, the ESP32 forces the STM to
                DANGER for this long so it runs Emergency_Action. (The 3-byte
                link has no per-target control or real ACK.)

        config WELLHOUSE_UTC_OFFSET_MIN
            int "Local time offset from UTC (minutes)"
            range -720 840
            default 540
            help
                Used to build the hour:minute clock sent to the STM 7-segment
                display. KST (UTC+9) = 540.

        config WELLHOUSE_EVENT_QUEUE_CAP
            int "Offline event queue capacity"
            range 8 512
            default 64
            help
                Max number of uplink events buffered in NVS while offline.
                Oldest events are dropped when full.
    endmenu

    menu "Water: ADC mapping & risk thresholds"
        config WELLHOUSE_WATER_ADC_ZERO
            int "ADC reading at 0 cm"
            range 0 4095
            default 500

        config WELLHOUSE_WATER_ADC_PER_CM
            int "ADC counts per cm"
            range 1 4095
            default 300
            help
                level_cm = (adc - zero) / per_cm. Calibrate to your sensor.

        config WELLHOUSE_THR_WARNING
            int "ADC threshold: WARNING"
            range 0 4095
            default 500

        config WELLHOUSE_THR_ALERT
            int "ADC threshold: ALERT"
            range 0 4095
            default 1200

        config WELLHOUSE_THR_DANGER
            int "ADC threshold: DANGER"
            range 0 4095
            default 2500
            help
                State byte sent to the STM: >=DANGER -> 3, >=ALERT -> 2,
                >=WARNING -> 1, else 0. The STM actuates on ALERT/DANGER.
    endmenu

    menu "SPI link to STM (ESP32 is master, 3-byte exchange)"
        config WELLHOUSE_SPI_MISO
            int "MISO GPIO (STM -> ESP32)"
            default 19

        config WELLHOUSE_SPI_MOSI
            int "MOSI GPIO (ESP32 -> STM)"
            default 23

        config WELLHOUSE_SPI_SCLK
            int "SCLK GPIO"
            default 18

        config WELLHOUSE_SPI_CS
            int "CS GPIO (drives the STM's hardware NSS)"
            default 5

        config WELLHOUSE_SPI_CLOCK_HZ
            int "SPI clock (Hz)"
            range 100000 20000000
            default 1000000

        config WELLHOUSE_SPI_POLL_MS
            int "SPI poll interval (ms)"
            range 20 2000
            default 100
            help
                How often the ESP32 clocks a 3-byte transaction. Keep it short
                relative to the STM's loop so exchanges land in its SPI window.
    endmenu

endmenu
```

## sdkconfig.defaults
```kconfig
# WellHouse firmware defaults (applied on a fresh build; run menuconfig to tweak)

# Bigger main task stack: app_main brings up several subsystems + TLS.
CONFIG_ESP_MAIN_TASK_STACK_SIZE=6144

# TLS: validate mqtts:// broker certs against the bundled CA store.
CONFIG_MBEDTLS_CERTIFICATE_BUNDLE=y
CONFIG_MBEDTLS_CERTIFICATE_BUNDLE_DEFAULT_FULL=y
CONFIG_ESP_TLS_USING_MBEDTLS=y

# Give FreeRTOS 1 kHz tick for tighter SPI/command timing.
CONFIG_FREERTOS_HZ=1000

# ---- WellHouse identity / network ----
# DEVICE_ID must match a device the backend knows. The dev seed creates
# "demo-device-01" (pairingCode 123456), so this default pairs out of the box.
CONFIG_WELLHOUSE_DEVICE_ID="demo-device-01"
# Broker + Wi-Fi are site-specific — set them via `idf.py menuconfig`
# -> "WellHouse Configuration" (secrets stay out of git):
#   MQTT broker URI : mqtt://<backend-PC-LAN-IP>:1883   (e.g. mqtt://10.162.191.207:1883)
#   Wi-Fi SSID / password : your network (ESP32 needs 2.4 GHz)
# The backend must run with MQTT enabled against the same broker — see docs/INTEGRATION.md.
```
